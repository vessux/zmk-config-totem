base2_layer {
// ┏━━━━━━━━━━━━━━━━━━━━━━━━━━━━━━━━━━━━━━━┓
label= "BASE2"                             ;
// ┗━━━━━━━━━━━━━━━━━━━━━━━━━━━━━━━━━━━━━━━┛
//             ┏━━━━━━━━━━━┳━━━━━━━━━━━┳━━━━━━━━━━━┳━━━━━━━━━━━┳━━━━━━━━━━━┓   ┏━━━━━━━━━━━┳━━━━━━━━━━━┳━━━━━━━━━━━┳━━━━━━━━━━━┳━━━━━━━━━━━┓
//             ┃     V     ┃     M     ┃     L     ┃     C     ┃     P     ┃   ┃     B     ┃  MAGIC    ┃     U     ┃     O     ┃     ,     ┃
//             ┣━━━━━━━━━━━╋━━━━━━━━━━━╋━━━━━━━━━━━╋━━━━━━━━━━━╋━━━━━━━━━━━┫   ┣━━━━━━━━━━━╋━━━━━━━━━━━╋━━━━━━━━━━━╋━━━━━━━━━━━╋━━━━━━━━━━━┫
//             ┃     S     ┃     T     ┃     R     ┃     D     ┃     Y     ┃   ┃     F     ┃     N     ┃     E     ┃     A     ┃     I     ┃
// ┏━━━━━━━━━━━╋━━━━━━━━━━━╋━━━━━━━━━━━╋━━━━━━━━━━━╋━━━━━━━━━━━╋━━━━━━━━━━━┫   ┣━━━━━━━━━━━╋━━━━━━━━━━━╋━━━━━━━━━━━╋━━━━━━━━━━━╋━━━━━━━━━━━╋━━━━━━━━━━━┓
// ┃  CZ LEAD  ┃     X     ┃     K     ┃     J     ┃     G     ┃     W     ┃   ┃     Z     ┃     H     ┃     '     ┃     ?     ┃     .     ┃  CZ LEAD  ┃
// ┗━━━━━━━━━━━┻━━━━━━━━━━━┻━━━━━━━━━━━╋━━━━━━━━━━━╋━━━━━━━━━━━╋━━━━━━━━━━━┫   ┣━━━━━━━━━━━╋━━━━━━━━━━━╋━━━━━━━━━━━╋━━━━━━━━━━━┻━━━━━━━━━━━┻━━━━━━━━━━━┛
//                                     ┃    DEL    ┃   SPACE   ┃    TAB    ┃   ┃ SMARTREP  ┃   ENTER   ┃   BSPC    ┃
//                                     ┗━━━━━━━━━━━┻━━━━━━━━━━━┻━━━━━━━━━━━┛   ┗━━━━━━━━━━━┻━━━━━━━━━━━┻━━━━━━━━━━━┛
 bindings = <
// ╷           ╷           ╷           ╷           ╷           ╷           ╷   ╷           ╷           ╷           ╷           ╷           ╷           ╷

                &kp V       &kp M       &kp L       &kp C         &kp P           &kp B       &magic_key  &kp U       &kp O       &kp COMMA
                &hml LGUI S &hml LALT T &hml LCTRL R &hml LSHFT D &kp Y           &kp F       &hmr RSHFT N &hmr RCTRL E &hmr RALT A &hmr RGUI I
    &cz         &kp X       &kp K       &kp J       &kp G         &kp W           &kp Z       &kp H       &kp SQT     &kp QMARK   &kp DOT     &cz
                                        &trans      &trans        &trans          &smart_repeat &trans    &trans
                        >;
}; 